/* WirelessPi WPS transport adapter; GPL-3.0-or-later.
 * The SDK owns WPS tasks, callbacks, scan and connection initialization.
 * The selected-BSSID registrar extension is generated by tools/wifite_sdk_adapter.py.
 */
#include "link.h"
#include "sdk_adapter.h"
#include <esp_idf_version.h>
#include <esp_private/wifi.h>
#include <esp_wifi.h>
#include <esp_wps.h>
#include <string.h>

#if ESP_IDF_VERSION != ESP_IDF_VERSION_VAL(5, 5, 4)
#error "WIFITE WPS adapter requires the pinned ESP-IDF 5.5.4"
#endif

static WfLinkCallbacks callbacks;
static bool installed, enabled;

esp_err_t wf_link_install(const WfLinkCallbacks *cb) {
  if (installed || !cb || !cb->accept || !cb->ready || !cb->receive)
    return ESP_ERR_INVALID_STATE;
  callbacks = *cb;
  installed = true;
  return ESP_OK;
}

esp_err_t wf_link_connect(const WfTarget *target) {
  if (!installed || enabled || !target || !target->ssid_len ||
      target->ssid_len > 32 || target->channel < 1 || target->channel > 14)
    return ESP_ERR_INVALID_STATE;
  esp_err_t err = esp_wifi_set_promiscuous(false);
  bool sniffing = true;
  if (err == ESP_OK)
    err = esp_wifi_get_promiscuous(&sniffing);
  if (err == ESP_OK && sniffing)
    err = ESP_ERR_INVALID_STATE;
  if (err != ESP_OK)
    return err;
  /* Avoid reusing scan/connect state from a previous attempt. */
  err = esp_wifi_disconnect();
  if (err != ESP_OK && err != ESP_ERR_WIFI_NOT_CONNECT)
    return err;
  const esp_wps_config_t config = WPS_CONFIG_INIT_DEFAULT(WPS_TYPE_PIN);
  err = esp_wifi_wps_enable(&config);
  if (err != ESP_OK)
    return err;
  enabled = true;
  err = wf_sdk_prepare(target->bssid, target->channel,
                       callbacks.ready, callbacks.receive);
  if (err == ESP_OK)
    err = esp_wifi_wps_start(0);
  if (err != ESP_OK)
    wf_link_disconnect();
  return err;
}

esp_err_t wf_link_send(const uint8_t *ethernet, size_t n) {
  if (!installed || !enabled || !ethernet || n < 18 || n > 1514)
    return ESP_ERR_INVALID_ARG;
  return esp_wifi_internal_tx(WIFI_IF_STA, (void *)ethernet, n);
}

void wf_link_disconnect(void) {
  if (!enabled)
    return;
  /* Stop an in-flight discovery before the SDK releases its WPS state. */
  esp_wifi_scan_stop();
  /* Disable joins the SDK WPS task, cancels its timers and releases callbacks. */
  esp_wifi_wps_disable();
  wf_sdk_clear();
  esp_wifi_disconnect();
  enabled = false;
}

void wf_link_uninstall(void) {
  if (!installed)
    return;
  wf_link_disconnect();
  installed = false;
}
